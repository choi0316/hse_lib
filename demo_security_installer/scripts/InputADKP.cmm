
&INPUT_FILE="adkp_key_input.txt"
LOCAL &input_data
Var.NewLocal char \counter
Var.NewLocal char \adkp_size
;Initialize variable
&input_data1=0
Var.Assign \counter=0
;Open file
OPEN #1 &INPUT_FILE /READ
;Read data from File
READ #1 %LINE &input_data
CLOSE #1

OPEN #1 configuration_APP.txt /CREATE
WRITE #1 "&input_data"

CLOSE #1
Var.Assign \adkp_size = 15
PRINT "Data from file:&input_data"
Repeat 16.
(
    Var.Assign applicationDebugKeyPassword[\adkp_size]=((&input_data >> (8 * \counter)) & 0xFF)
    Var.Assign \counter=(\counter+1)
    Var.Assign \adkp_size=(\adkp_size-1)
)

ENDDO
