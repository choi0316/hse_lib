;set up JTAG access subroutine macros
	GOSUB JTAG_SetupMacros
	&Security_JDC_CMD=0x90
	&Security_JDC_IR_LEN=0x8
	&Sec_JDC_JOUT_READ=0x2
	&Sec_JDC_JOUT_READ_LEN=0x5
	&JOUT_READY=0x0
	&HSE_Chrp_CHL0=0x0
	&HSE_Chrp_CHL1=0x0
	&HSE_Chrp_CHL2=0x0
	&HSE_Chrp_CHL3=0x0
	&HSE_Chrp_CHL4=0x0
	&HSE_Chrp_CHL5=0x0
	&HSE_Chrp_CHL6=0x0
	&HSE_Chrp_CHL7=0x0

	

;we are in SYStem.DOWN and have to initialize JTAG port
  	JTAG.LOCK                         ;exclusive control of the JTAG port
  	JTAG.PIN ENABLE                   ;enable JTAG pin drivers output
	SYStem.JtagClock 200khz
 	&JTAG_ResetStateMachine	    	;Reset JTAG state machine	
	SYStem.JtagClock 200khz
 
;==========================Security JDC TAP ENTER-Enter=======================================
//  PRINT "ENABLE Security JDC TAP"
  &JTAG_ReadWriteIR &Security_JDC_CMD &Security_JDC_IR_LEN  
;==========================Security JDC TAP ENTER-Exit=======================================

;==========================Security JDC REGISTER ACCESS-ENTER=======================================
//  PRINT "Security JDC REGISTER READ Test-Start"
  &JTAG_ReadWriteIR &Sec_JDC_JOUT_READ &Sec_JDC_JOUT_READ_LEN  
;==========================Security JDC REGISTER ACCESS-Exit=======================================
;==========================Security JDC Read Challenge - 0-Enter=======================================
	&JTAG_GOTO_SHIFTDR
WHILE &JOUT_READY!=1
	(
	JTAG.SHIFTTMS 1 1 1 0 0 
	JTAG.SHIFTTDI 0
	&JOUT_READY = JTAG.SHIFT()
	;PRINT "WAITING FOR JOUT_READY"
	)
	JTAG.SHIFTTDI 0 	;read out JIN_READY
	
	;Read Challenge
	
	IF &JOUT_READY==1
	(
	JTAG.SHIFTTDI %Long 0x00000000
	&HSE_Chrp_CHL0=JTAG.SHIFT()
	JTAG.SHIFTTDI %Long 0x00000000
	&HSE_Chrp_CHL1=JTAG.SHIFT()
	JTAG.SHIFTTDI %Long 0x00000000
	&HSE_Chrp_CHL2=JTAG.SHIFT()
	JTAG.SHIFTTDI %Long 0x00000000
	&HSE_Chrp_CHL3=JTAG.SHIFT()
	JTAG.SHIFTTDI %Long 0x00000000
	&HSE_Chrp_CHL4=JTAG.SHIFT()
	JTAG.SHIFTTDI %Long 0x00000000
	&HSE_Chrp_CHL5=JTAG.SHIFT()
	JTAG.SHIFTTDI %Long 0x00000000
	&HSE_Chrp_CHL6=JTAG.SHIFT()
	JTAG.SHIFTREG %Long 0x00000000
	&HSE_Chrp_CHL7=JTAG.SHIFT()
	&JTAG_GOTO_RT_IDLE
	)
//	PRINT "Challenge: "
//	PRINT &HSE_Chrp_CHL0
//        PRINT &HSE_Chrp_CHL1
//	PRINT &HSE_Chrp_CHL2
//        PRINT &HSE_Chrp_CHL3
//	PRINT &HSE_Chrp_CHL4
//        PRINT &HSE_Chrp_CHL5
//	PRINT &HSE_Chrp_CHL6
//        PRINT &HSE_Chrp_CHL7
OPEN #1 .\challenge.txt /Create
WRITE #1 "&HSE_Chrp_CHL0: " "&HSE_Chrp_CHL1: " "&HSE_Chrp_CHL2: " "&HSE_Chrp_CHL3: " "&HSE_Chrp_CHL4: " "&HSE_Chrp_CHL5: " "&HSE_Chrp_CHL6: " "&HSE_Chrp_CHL7: "
CLOSE #1

&JTAG_ResetStateMachine	    ;Reset JTAG state machine	

 JTAG.UNLOCK
 ENDDO &HSE_Chrp_CHL0 &HSE_Chrp_CHL1 &HSE_Chrp_CHL2 &HSE_Chrp_CHL3 &HSE_Chrp_CHL4 &HSE_Chrp_CHL5 &HSE_Chrp_CHL6 &HSE_Chrp_CHL7

;--------------------------------------------------------------------------------------------
JTAG_SetupMacros:
  GLOBAL &JTAG_ResetStateMachine
  &JTAG_ResetStateMachine="GOSUB JTAG_ResetStateMachine"

  GLOBAL &JTAG_GOTO_SHIFTIR &JTAG_GOTO_SHIFTDR &JTAG_GOTO_RT_IDLE
  &JTAG_GOTO_SHIFTIR="JTAG.SHIFTTMS 1 1 0 0" ;RUN-TEST/IDLE ---> SHIFT-IR
  &JTAG_GOTO_SHIFTDR="JTAG.SHIFTTMS 1 0 0"   ;RUN-TEST/IDLE ---> SHIFT-DR
  &JTAG_GOTO_RT_IDLE="JTAG.SHIFTTMS 1 0"     ;Exit1-DR/Exit1-IR  ---> RUN-TEST/IDLE
  &JTAG_GOTO_RT_IDLE_LEAVETAP="JTAG.SHIFTTMS 1 0 1 0 1 1 0"    ;walk through PAUSE-DR/IR to select JTAGC
  &JTAG_GOTO_SHIFTDR_SAMETAP="JTAG.SHIFTTMS 1 1 1 0 0"   ;SHIFT-DR ---> SHIFT-DR



  GLOBAL &JTAG_ReadWriteIR &JTAG_WriteDR &JTAG_ReadDR
  &JTAG_ReadWriteIR="GOSUB JTAG_ReadWriteIR "
  &JTAG_WriteDR="GOSUB JTAG_WriteDR "
  &JTAG_ReadDR="GOSUB JTAG_ReadDR "

  GLOBAL &JTAG_WriteNexusReg &JTAG_ReadNexusReg
  &JTAG_WriteNexusReg="GOSUB JTAG_WriteNexusReg "
  &JTAG_ReadNexusReg="GOSUB JTAG_ReadNexusReg "
  RETURN

JTAG_ResetStateMachine: ;reset JTAG state machine and go to RUN-TEST/IDLE
  JTAG.PIN NTRST 1               ;release TRST(JCOMP)
  JTAG.PIN NTRST 0               ;assert TRST(JCOMP)
  WAIT 100.ms
  JTAG.PIN NTRST 1               ;release TRST(JCOMP)
  WAIT 100.ms
  JTAG.SHIFTTMS 0                ;go to RUN-TEST/IDLE
;additional JTAG init (for processors without JCOMP)
  JTAG.SHIFTTMS 1 1 1 1 1 1 1 0  ;go via TEST-LOGIC-RESET to RUN-TEST/IDLE
  JTAG.SHIFTTMS 1 0 1 0 1 1 0    ;walk through PAUSE-DR to select JTAGC
  RETURN

JTAG_ReadWriteIR:   ;send a JTAG instruction of specified length
  LOCAL &command &length
  ENTRY &command &length
  GOSUB JTAG_MakeBitStream &command &length
  ENTRY %line &bitstream
  &JTAG_GOTO_SHIFTIR
  JTAG.SHIFTREG &bitstream
  &value=JTAG.SHIFT()
  &JTAG_GOTO_RT_IDLE
  RETURN &value

JTAG_ReadDR:   ;read DR
  LOCAL &length
  ENTRY &length
  GOSUB JTAG_MakeBitStream 0 &length
  ENTRY %line &bitstream
  &JTAG_GOTO_SHIFTDR
  JTAG.SHIFTREG &bitstream
  &value=JTAG.SHIFT()
  &JTAG_GOTO_RT_IDLE
  RETURN &value

JTAG_WriteDR:   ;write DR
  LOCAL &value &length
  ENTRY &value &length
  GOSUB JTAG_MakeBitStream &value &length
  ENTRY %line &bitstream
  &JTAG_GOTO_SHIFTDR
  JTAG.SHIFTREG &bitstream
  &JTAG_GOTO_RT_IDLE
  RETURN
  
JTAG_WriteDR8:   ;write DR
  LOCAL &value0 &value1 &value2 &value3 &value4 &value5 &value6 &value7 &length
  ENTRY &value0 &value1 &value2 &value3 &value4 &value5 &value6 &value7 &length
  GOSUB JTAG_MakeBitStream &value0 &length
  ENTRY %line &bitstream
  &JTAG_GOTO_SHIFTDR
  JTAG.SHIFTREG &bitstream
  GOSUB JTAG_MakeBitStream &value1 &length
  ENTRY %line &bitstream
  JTAG.SHIFTREG &bitstream
  GOSUB JTAG_MakeBitStream &value2 &length
  ENTRY %line &bitstream
  JTAG.SHIFTREG &bitstream
  GOSUB JTAG_MakeBitStream &value3 &length
  ENTRY %line &bitstream
  JTAG.SHIFTREG &bitstream
  GOSUB JTAG_MakeBitStream &value4 &length
  ENTRY %line &bitstream
  JTAG.SHIFTREG &bitstream
  GOSUB JTAG_MakeBitStream &value5 &length
  ENTRY %line &bitstream
  JTAG.SHIFTREG &bitstream
  GOSUB JTAG_MakeBitStream &value6 &length
  ENTRY %line &bitstream
  JTAG.SHIFTREG &bitstream
  GOSUB JTAG_MakeBitStream &value7 &length
  ENTRY %line &bitstream
  JTAG.SHIFTREG &bitstream
  &JTAG_GOTO_RT_IDLE
  RETURN
  
  

JTAG_ReadNexusReg: ;read a 32-bit register of the nexus block
  LOCAL &regindex
  ENTRY &regindex
  &command=(&regindex<<1)|0x00 ;read
  &JTAG_GOTO_SHIFTDR
  JTAG.SHIFTREG %byte &command
  &JTAG_GOTO_RT_IDLE
  &JTAG_GOTO_SHIFTDR
  JTAG.SHIFTREG %long 0x00000000
  &value=JTAG.SHIFT()
  &JTAG_GOTO_RT_IDLE
  RETURN &value

JTAG_WriteNexusReg: ;write a 32-bit register of the nexus block
  LOCAL &regindex &value
  ENTRY &regindex &value
  &JTAG_GOTO_SHIFTDR
  &command=(&regindex<<1)|0x01 ;write
  JTAG.SHIFTREG %byte &command
  &JTAG_GOTO_RT_IDLE
  &JTAG_GOTO_SHIFTDR
  JTAG.SHIFTREG %long &value
  &JTAG_GOTO_RT_IDLE
  RETURN

JTAG_MakeBitStream: ;convert a value into a bit stream (max. 32 bit)
  LOCAL &value &length
  ENTRY &value &length
  &bitstream=""
  while &length>0
  (
    if (&value&0x00000001)!=0
      &bitstream="&bitstream 1"
    else
      &bitstream="&bitstream 0"
    &length=&length-1
    &value=&value>>1.
  )
  RETURN &bitstream
