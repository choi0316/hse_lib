cd.do attach_core_m7_0.cmm

cd.do system_setup.cmm

GLOBAL &backup_ivt_marker

&backup_ivt_marker = Data.long(SD:0x420000)

Var.if ( 0x5AA55AA5 == &backup_ivt_marker )
    data.save.binary ..\images\backup_ivt.bin 0x420000++0xFF

&FlashDriverLoadAddr=0x20400000

Data.Set SD:&FlashDriverLoadAddr++0x1FFF %LE %Quad 0x0

FLASH.RESet

FLASH.Create 1. 0x00400000--0x0047FFFF 0x2000 TARGET long                    ;Block 0 512kb of code flash except of last 48kb which will have SBAF
FLASH.TARGET &FlashDriverLoadAddr 0x21002000 0x1000 ~~/demo/arm/flash/long/&FlashDriver
Data.load.binary "~~/demo/arm/flash/long/&FlashDriver" &FlashDriverLoadAddr

;Case when IVT authentication is enabled, 2 backup ivt's are programmed at these locations.
Var.if ( 0x5AA55AA5 == &backup_ivt_marker )
    FLASH.ChangeType 0x00420000--0x423FFF NOP

;do not remove sbaf and HSE FW in case of k311 device
FLASH.ChangeType 0x00454000--0x0047FFFF NOP

Flash.ReProgram ALL /Erase

;IVT programming
Var.if ( 0x5AA55AA5 == &backup_ivt_marker )
    data.load.binary "..\images\backup_ivt.bin" 0x00400000++0xFF
else
    data.load.binary "..\images\ivt.bin" 0x00400000++0xEF


;Program XRDC Configuration provided by User
;data.load.binary "..\images\S32K3xx_flash_XRDC.bin" 0x0041E100++0x100

IF ("&CONFIG"=="GHS")
(
    IF ("&fwtype"=="STANDARD")
    (
        ;load secure boot app
        IF OS.FILE.EXIST(..\Projects\GHS\SecureBootApp\bin\secure_boot_app.elf)==TRUE()
            data.load.elf "..\Projects\GHS\SecureBootApp\bin\secure_boot_app.elf"
        ELSE
            data.load.s1record "..\Projects\GHS\SecureBootApp\bin\secure_boot_app.run"
    )


    ;load demo app
    IF OS.FILE.EXIST(..\Projects\GHS\demo_app\bin\demo_app.elf)==TRUE()
        data.load.elf "..\Projects\GHS\demo_app\bin\demo_app.elf
    ELSE
        data.load.s1record "..\Projects\GHS\demo_app\bin\demo_app.run"
)
ELSE
(
    IF ("&fwtype"=="STANDARD")
    (
        ;load secure boot app
        IF OS.FILE.EXIST(..\Projects\S32DS\SecureBootApp\Debug_FLASH\secure_boot_app.elf)==TRUE()
            data.load.elf "..\Projects\S32DS\SecureBootApp\Debug_FLASH\secure_boot_app.elf"
        ELSE
            data.load.s1record "..\Projects\S32DS\SecureBootApp\Debug_FLASH\secure_boot_app.srec"
    )

    ;demo app, if elf present then load that else load srec
    IF OS.FILE.EXIST(..\Projects\S32DS\demo_app\S32K3xx\bin\&SOC_ID\S32K3XX_demo_app.elf)==TRUE()
        data.load.elf "..\Projects\S32DS\demo_app\S32K3xx\bin\&SOC_ID\S32K3XX_demo_app.elf"
    ELSE
        data.load.s1record "..\Projects\S32DS\demo_app\S32K3xx\bin\&SOC_ID\S32K3XX_demo_app.srec"
)

FLASH.ReProgram OFF
Data.Set SD:&FlashDriverLoadAddr++0x1FFF %LE %Quad 0x0

DIALOG.MESSAGE "Demo app binary flashed, functional reset will be issued next."

cd.do Issue_FunctionalReset_MC_ME.cmm
