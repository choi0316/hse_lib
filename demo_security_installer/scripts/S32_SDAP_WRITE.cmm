ENTRY &arg1 &arg2 &arg3 &arg4 &arg5 &arg6 &arg7 &arg8  
;Script to Check if CM7 Core is halted and Debugger is connected or not
;Created by Aakash K. , 22th Nov.2019

Global &SDAP_AUTHSTTS
Global &SDAP_AUTHCTL 
Global &SDAP_KEYCHAL_0 
Global &SDAP_KEYCHAL_1 
Global &SDAP_KEYCHAL_2 
Global &SDAP_KEYCHAL_3 
Global &SDAP_KEYCHAL_4 
Global &SDAP_KEYCHAL_5 
Global &SDAP_KEYCHAL_6 
Global &SDAP_KEYCHAL_7 

&SDAP_BASE_ADDRESS=0x40000700
&SDAP_AUTHSTTS = &SDAP_BASE_ADDRESS
&SDAP_AUTHCTL  = &SDAP_BASE_ADDRESS+0x4

&SDAP_KEYRESP_0 = &SDAP_BASE_ADDRESS+0x40
&SDAP_KEYRESP_1 = &SDAP_BASE_ADDRESS+0x44
&SDAP_KEYRESP_2 = &SDAP_BASE_ADDRESS+0x48
&SDAP_KEYRESP_3 = &SDAP_BASE_ADDRESS+0x4C
&SDAP_KEYRESP_4 = &SDAP_BASE_ADDRESS+0x50
&SDAP_KEYRESP_5 = &SDAP_BASE_ADDRESS+0x54
&SDAP_KEYRESP_6 = &SDAP_BASE_ADDRESS+0x58
&SDAP_KEYRESP_7 = &SDAP_BASE_ADDRESS+0x5C

&SDAP_DBGENCTRL = &SDAP_BASE_ADDRESS+0x80
&SDAP_SDAAPRSTCTRL = &SDAP_BASE_ADDRESS+0x90
&SDAP_SDAAPGENCTRL0 = &SDAP_BASE_ADDRESS+0xA4
&SDAP_DAP_GEN1_CTRL = &SDAP_BASE_ADDRESS+0xB4

sys.mode prepare
	
	
	;Enable SDAP Based Debug Authorization
	data.set EDBG:&SDAP_SDAAPGENCTRL0 %LE %Long 0x00000001
	
	local &rdata
	
	&rdata=Data.long(EDBG:&SDAP_AUTHSTTS)&0x00000001
	while &rdata!=0x1
	(
		&rdata=Data.long(EDBG:&SDAP_AUTHSTTS)&0x00000001
	)

	data.set EDBG:&SDAP_KEYRESP_0 %LE %Long &arg1
	data.set EDBG:&SDAP_KEYRESP_1 %LE %Long &arg2
	data.set EDBG:&SDAP_KEYRESP_2 %LE %Long &arg3
	data.set EDBG:&SDAP_KEYRESP_3 %LE %Long &arg4
	data.set EDBG:&SDAP_KEYRESP_4 %LE %Long &arg5
	data.set EDBG:&SDAP_KEYRESP_5 %LE %Long &arg6
	data.set EDBG:&SDAP_KEYRESP_6 %LE %Long &arg7
	data.set EDBG:&SDAP_KEYRESP_7 %LE %Long &arg8
	
	data.set EDBG:&SDAP_AUTHCTL %LE %Long 0x00000001
    ENDDO

